## market/perf_test/Kconfig
```kconfig
config YMBOT_PERFORMANCE_TEST
	bool "YMBOT micro-ROS Performance Test"
	default n
	depends on UROS
	---help---
		Test micro-ROS and middleware with different payloads.
```

## market/testing/exti/Kconfig
```kconfig
config TESTING_EXTI
	tristate "Button EXTI test"
	default n
	---help---
		Enable EXTI test

		For the tests to be successful, you need to enable
		CONFIG_ARCH_BUTTONS, CONFIG_ARCH_IRQBUTTONS.
```
